# file: SPI_Slave.ioc
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Mcu.Family=STM32F1
Mcu.Name=STM32F103C(8-B)Tx
Mcu.Package=LQFP48
NVIC.PriorityGroup=NVIC_PRIORITYGROUP_4
PA13.Mode=Serial_Wire
PA13.Signal=SYS_JTMS-SWDIO
PA14.Mode=Serial_Wire
PA14.Signal=SYS_JTCK-SWCLK
ProjectManager.HeapSize=0x200
ProjectManager.StackSize=0x400
ProjectManager.TargetToolchain=STM32CubeIDE
RCC.APB1Freq_Value=8000000
RCC.APB2Freq_Value=8000000
board=custom

// file: Core/Src/main.c
/* USER CODE BEGIN Header */
/**
  ******************************************************************************
  * @file           : main.c
  * @brief          : Main program body
  ******************************************************************************
  * @attention
  *
  * Copyright (c) 2024 STMicroelectronics.
  * All rights reserved.
  *
  * This software is licensed under terms that can be found in the LICENSE file
  * in the root directory of this software component.
  * If no LICENSE file comes with this software, it is provided AS-IS.
  *
  ******************************************************************************
  */
/* USER CODE END Header */
#include "main.h"

/* USER CODE BEGIN PV */
uint8_t recv = 0;
uint8_t data = 0;
uint8_t temp =0;
/* USER CODE END PV */

void SystemClock_Config(void);
static void MX_GPIO_Init(void);

/* USER CODE BEGIN 0 */

void spi_init_slave()
{
	RCC->APB2ENR |=  (1<<2);  // Enable GPIOA clock

	GPIOA->CRL = 0;
	GPIOA->CRL |= (1<<22);   // PA5 (SCK) Input floating
	GPIOA->CRL |= (1<<28);   // PA7 (MOSI) Input floating
	GPIOA->CRL |= (11U<<24);    // PA6 (MISO) AF Push Pull
	//GPIOA->CRL |= (3<<16);    // PA4 used for CS, GPIO Output
	GPIOA->CRL |= (1<<18);

	//init spi1 in master

	__HAL_RCC_SPI1_CLK_ENABLE(); //enable 8Mhz clock spi
	SPI1->CR1 |= (1<<0)|(1<<1);   // CPOL=1, CPHA=1
	SPI1 ->CR1 &= ~(1<<2);		//slave mode
	SPI1->CR1 |= (3<<3);  // BR[2:0] = 011: fPCLK/16, PCLK2 = 8MHz, SPI clk = 500kHz
	SPI1->CR1 &= ~(1<<9);  // SSM=0

	SPI1->CR1 &= ~(1<<11);  // DFF=0, 8 bit data

	SPI1->CR1 &= ~(1<<7);  // MSB first
	//SPI1->CR1 |= (1<<7);  // LSB first
	SPI1->CR1 &= ~(1<<10);  // full-duplex
	SPI1->CR1 |= (1<<6); //enable SPI

	//GPIOA -> ODR |= (1<<4);
}

char spi_read_data(char reg)
{
//	while(((SPI1 -> SR >>1)&1) != 1); //wait Tx empty to write data DR
//   SPI1 -> DR = reg;
   //while(((SPI1 -> SR >>1)&1) == 1); //wait data be transfered to Tx buffer
   while(((SPI1 -> SR >>0)&1) != 1); //wait RXNE not empty (has recv data) to read data
   while(((SPI1 -> SR>>7)&1) == 1); //wait not busy
//	while (((SPI1->SR)&(1<<7))) {};  // wait for BSY bit to Reset -> This will indicate that SPI is not busy in communication
//			SPI1->DR = 0;  // send dummy data
//			while (!((SPI1->SR) &(1<<0))){};
   //read data from DR
   temp = SPI1 -> DR;
   //if(temp){
	   	while(((SPI1 -> SR >>1)&1) != 1); //wait Tx empty to write data DR
	      SPI1 -> DR = reg;
   //}
   return temp;
}
/* USER CODE END 0 */

int main(void)
{

  /* MCU Configuration--------------------------------------------------------*/

  /* Reset of all peripherals, Initializes the Flash interface and the Systick. */
  HAL_Init();

  /* USER CODE BEGIN Init */
	//initialise_monitor_handles();
  /* USER CODE END Init */

  /* Configure the system clock */
  SystemClock_Config();

  /* Initialize all configured peripherals */
  MX_GPIO_Init();
  /* USER CODE BEGIN 2 */
  spi_init_slave();
  //spi_init_slave();
  /* USER CODE END 2 */

  /* Infinite loop */
  while (1)
  {

    /* USER CODE BEGIN 3 */
	  recv = spi_read_data(0x77);
  }
  /* USER CODE END 3 */
}

void SystemClock_Config(void)
{
  RCC_OscInitTypeDef RCC_OscInitStruct = {0};
  RCC_ClkInitTypeDef RCC_ClkInitStruct = {0};

  /** Initializes the RCC Oscillators according to the specified parameters
  * in the RCC_OscInitTypeDef structure.
  */
  RCC_OscInitStruct.OscillatorType = RCC_OSCILLATORTYPE_HSI;
  RCC_OscInitStruct.HSIState = RCC_HSI_ON;
  RCC_OscInitStruct.HSICalibrationValue = RCC_HSICALIBRATION_DEFAULT;
  RCC_OscInitStruct.PLL.PLLState = RCC_PLL_NONE;
  if (HAL_RCC_OscConfig(&RCC_OscInitStruct) != HAL_OK)
  {
    Error_Handler();
  }

  /** Initializes the CPU, AHB and APB buses clocks
  */
  RCC_ClkInitStruct.ClockType = RCC_CLOCKTYPE_HCLK|RCC_CLOCKTYPE_SYSCLK
                              |RCC_CLOCKTYPE_PCLK1|RCC_CLOCKTYPE_PCLK2;
  RCC_ClkInitStruct.SYSCLKSource = RCC_SYSCLKSOURCE_HSI;
  RCC_ClkInitStruct.AHBCLKDivider = RCC_SYSCLK_DIV1;
  RCC_ClkInitStruct.APB1CLKDivider = RCC_HCLK_DIV1;
  RCC_ClkInitStruct.APB2CLKDivider = RCC_HCLK_DIV1;

  if (HAL_RCC_ClockConfig(&RCC_ClkInitStruct, FLASH_LATENCY_0) != HAL_OK)
  {
    Error_Handler();
  }
}

static void MX_GPIO_Init(void)
{

  /* GPIO Ports Clock Enable */
  __HAL_RCC_GPIOA_CLK_ENABLE();

}

void Error_Handler(void)
{
  __disable_irq();
  while (1)
  {
  }
}
