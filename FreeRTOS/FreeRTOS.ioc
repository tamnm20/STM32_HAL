# file: FreeRTOS.ioc
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FREERTOS.Mutexes01=log,Dynamic,NULL
FREERTOS.Queues01=temp,32,float,0,Dynamic,NULL,NULL
FREERTOS.Tasks01=task1,24,128,func1,Default,NULL,Dynamic,NULL,NULL;task2,24,128,func2,Default,NULL,Dynamic,NULL,NULL;task3,24,256,func3,Default,NULL,Dynamic,NULL,NULL;task4,24,128,func4,Default,NULL,Dynamic,NULL,NULL
FREERTOS.configTOTAL_HEAP_SIZE=9216
Mcu.Family=STM32F1
Mcu.Name=STM32F103C(8-B)Tx
Mcu.Package=LQFP48
NVIC.PriorityGroup=NVIC_PRIORITYGROUP_4
PA13.Mode=Serial_Wire
PA13.Signal=SYS_JTMS-SWDIO
PA14.Mode=Serial_Wire
PA14.Signal=SYS_JTCK-SWCLK
PD0-OSC_IN.Mode=HSE-External-Oscillator
PD0-OSC_IN.Signal=RCC_OSC_IN
PD1-OSC_OUT.Mode=HSE-External-Oscillator
PD1-OSC_OUT.Signal=RCC_OSC_OUT
ProjectManager.HeapSize=0x200
ProjectManager.StackSize=0x400
ProjectManager.TargetToolchain=STM32CubeIDE
RCC.AHBFreq_Value=72000000
RCC.APB1CLKDivider=RCC_HCLK_DIV2
RCC.APB1Freq_Value=36000000
RCC.APB1TimFreq_Value=72000000
RCC.APB2Freq_Value=72000000
RCC.APB2TimFreq_Value=72000000
RCC.HCLKFreq_Value=72000000
RCC.PLLMUL=RCC_PLL_MUL9
RCC.PLLSourceVirtual=RCC_PLLSOURCE_HSE
RCC.SYSCLKFreq_VALUE=72000000
RCC.SYSCLKSource=RCC_SYSCLKSOURCE_PLLCLK
RCC.USBFreq_Value=72000000
VP_FREERTOS_VS_CMSIS_V2.Mode=CMSIS_V2
board=custom

// file: Core/Src/main.c
/* USER CODE BEGIN Header */
/**
  ******************************************************************************
  * @file           : main.c
  * @brief          : Main program body
  ******************************************************************************
  * @attention
  *
  * Copyright (c) 2024 STMicroelectronics.
  * All rights reserved.
  *
  * This software is licensed under terms that can be found in the LICENSE file
  * in the root directory of this software component.
  * If no LICENSE file comes with this software, it is provided AS-IS.
  *
  ******************************************************************************
  */
/* USER CODE END Header */
#include "main.h"
#include "cmsis_os.h"

/* USER CODE BEGIN Includes */
#include <stdio.h>
#include "uart.h"
#include "adc.h"

/* USER CODE END Includes */

/* USER CODE BEGIN PTD */
float temp_value =0;
/* USER CODE END PTD */

/* USER CODE BEGIN PD */
#define GPIOB_BASE_ARR 0x40010C00
void leds_init()
{
	//set PB12 in output push-pull
	__HAL_RCC_GPIOB_CLK_ENABLE();
	uint32_t * GPIOB_CRH = (uint32_t *) (GPIOB_BASE_ARR + 0x04);
	*GPIOB_CRH |= (0b11 << 16);// set PB12 in OUTPUT mode speed 50MHz

	*GPIOB_CRH &= ~(0b11 << 18); //set PB12 output push-pull

}
void led_toggle(){
	uint32_t * GPIOB_ODR = (uint32_t *) (GPIOB_BASE_ARR + 0x0C);

	if(((* GPIOB_ODR >> 12)&1)==0)
	{

		*GPIOB_ODR |= (1<<12);
	}
	else
	{
		*GPIOB_ODR &= ~(1<<12);
	}
}
/* USER CODE END PD */

/* Definitions for task1 */
osThreadId_t task1Handle;
const osThreadAttr_t task1_attributes = {
  .name = "task1",
  .stack_size = 128 * 4,
  .priority = (osPriority_t) osPriorityNormal,
};
/* Definitions for task2 */
osThreadId_t task2Handle;
const osThreadAttr_t task2_attributes = {
  .name = "task2",
  .stack_size = 128 * 4,
  .priority = (osPriority_t) osPriorityNormal,
};
/* Definitions for task3 */
osThreadId_t task3Handle;
const osThreadAttr_t task3_attributes = {
  .name = "task3",
  .stack_size = 256 * 4,
  .priority = (osPriority_t) osPriorityNormal,
};
/* Definitions for task4 */
osThreadId_t task4Handle;
const osThreadAttr_t task4_attributes = {
  .name = "task4",
  .stack_size = 128 * 4,
  .priority = (osPriority_t) osPriorityNormal,
};
/* Definitions for temp */
osMessageQueueId_t tempHandle;
const osMessageQueueAttr_t temp_attributes = {
  .name = "temp"
};
/* Definitions for log */
osMutexId_t logHandle;
const osMutexAttr_t log_attributes = {
  .name = "log"
};

void SystemClock_Config(void);
static void MX_GPIO_Init(void);
void func1(void *argument);
void func2(void *argument);
void func3(void *argument);
void func4(void *argument);

int main(void)
{
  /* USER CODE BEGIN 1 */
	initialise_monitor_handles();
  /* USER CODE END 1 */

  /* MCU Configuration--------------------------------------------------------*/

  /* Reset of all peripherals, Initializes the Flash interface and the Systick. */
  HAL_Init();

  /* Configure the system clock */
  SystemClock_Config();

  /* Initialize all configured peripherals */
  MX_GPIO_Init();
  /* USER CODE BEGIN 2 */
	UART1_init();
  /* USER CODE END 2 */

  /* Init scheduler */
  osKernelInitialize();
  /* Create the mutex(es) */
  /* creation of log */
  logHandle = osMutexNew(&log_attributes);

  /* Create the queue(s) */
  /* creation of temp */
  tempHandle = osMessageQueueNew (32, sizeof(float), &temp_attributes);

  /* Create the thread(s) */
  /* creation of task1 */
  task1Handle = osThreadNew(func1, NULL, &task1_attributes);

  /* creation of task2 */
  task2Handle = osThreadNew(func2, NULL, &task2_attributes);

  /* creation of task3 */
  task3Handle = osThreadNew(func3, NULL, &task3_attributes);

  /* creation of task4 */
  task4Handle = osThreadNew(func4, NULL, &task4_attributes);

  /* Start scheduler */
  osKernelStart();

  /* We should never get here as control is now taken by the scheduler */
  /* Infinite loop */
  /* USER CODE BEGIN WHILE */
	//initialise_monitor_handles();
  while (1)
  {
    /* USER CODE END WHILE */

  }
}

void SystemClock_Config(void)
{
  RCC_OscInitTypeDef RCC_OscInitStruct = {0};
  RCC_ClkInitTypeDef RCC_ClkInitStruct = {0};

  /** Initializes the RCC Oscillators according to the specified parameters
  * in the RCC_OscInitTypeDef structure.
  */
  RCC_OscInitStruct.OscillatorType = RCC_OSCILLATORTYPE_HSE;
  RCC_OscInitStruct.HSEState = RCC_HSE_ON;
  RCC_OscInitStruct.HSEPredivValue = RCC_HSE_PREDIV_DIV1;
  RCC_OscInitStruct.HSIState = RCC_HSI_ON;
  RCC_OscInitStruct.PLL.PLLState = RCC_PLL_ON;
  RCC_OscInitStruct.PLL.PLLSource = RCC_PLLSOURCE_HSE;
  RCC_OscInitStruct.PLL.PLLMUL = RCC_PLL_MUL9;
  if (HAL_RCC_OscConfig(&RCC_OscInitStruct) != HAL_OK)
  {
    Error_Handler();
  }

  /** Initializes the CPU, AHB and APB buses clocks
  */
  RCC_ClkInitStruct.ClockType = RCC_CLOCKTYPE_HCLK|RCC_CLOCKTYPE_SYSCLK
                              |RCC_CLOCKTYPE_PCLK1|RCC_CLOCKTYPE_PCLK2;
  RCC_ClkInitStruct.SYSCLKSource = RCC_SYSCLKSOURCE_PLLCLK;
  RCC_ClkInitStruct.AHBCLKDivider = RCC_SYSCLK_DIV1;
  RCC_ClkInitStruct.APB1CLKDivider = RCC_HCLK_DIV2;
  RCC_ClkInitStruct.APB2CLKDivider = RCC_HCLK_DIV1;

  if (HAL_RCC_ClockConfig(&RCC_ClkInitStruct, FLASH_LATENCY_2) != HAL_OK)
  {
    Error_Handler();
  }
}

static void MX_GPIO_Init(void)
{

  /* GPIO Ports Clock Enable */
  __HAL_RCC_GPIOD_CLK_ENABLE();
  __HAL_RCC_GPIOA_CLK_ENABLE();

}

void func1(void *argument)
{
  /* USER CODE BEGIN 5 */
  /* Infinite loop */
  for(;;)
  {
	  osMutexAcquire(logHandle, HAL_MAX_DELAY);
	uart_printf("xin chao");
	osMutexRelease(logHandle);
    osDelay(1000);
  }
  /* USER CODE END 5 */
}

void func2(void *argument)
{
  /* USER CODE BEGIN func2 */
	leds_init();
  /* Infinite loop */
  for(;;)
  {
	  led_toggle();
    osDelay(1000);
  }
  /* USER CODE END func2 */
}

void func3(void *argument)
{
  /* USER CODE BEGIN func3 */
	float temp =0;
  /* Infinite loop */
  for(;;)
  {
	uint32_t num_msg = osMessageQueueGetCount(tempHandle);
	osMutexAcquire(logHandle, HAL_MAX_DELAY);
	uart_printf("device temp:[");
	for(int i=0;i<num_msg;i++){
		osMessageQueueGet(tempHandle, &temp, 0, HAL_MAX_DELAY);
		uart_printf("%.2f, ",temp);
	}
	uart_printf("\b\b]\r\n");
	osMutexRelease(logHandle);
    osDelay(3000);
  }
  /* USER CODE END func3 */
}

void func4(void *argument)
{
  /* USER CODE BEGIN func4 */
	read_temp_init();
	float temp =0;
  /* Infinite loop */
  for(;;)
  {
	temp = adc_get_temp_ss();
	osMessageQueuePut(tempHandle, &temp, 0, HAL_MAX_DELAY);
    osDelay(1000);
  }
  /* USER CODE END func4 */
}

void Error_Handler(void)
{
  __disable_irq();
  while (1)
  {
  }
}
