# file: Blink_OCD.ioc
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Mcu.Family=STM32F1
Mcu.Name=STM32F103C(8-B)Tx
Mcu.Package=LQFP48
NVIC.PriorityGroup=NVIC_PRIORITYGROUP_4
PA13.Mode=Serial_Wire
PA13.Signal=SYS_JTMS-SWDIO
PA14.Mode=Serial_Wire
PA14.Signal=SYS_JTCK-SWCLK
PB2.Signal=GPIO_Output
ProjectManager.HeapSize=0x200
ProjectManager.StackSize=0x400
ProjectManager.TargetToolchain=STM32CubeIDE
RCC.APB1Freq_Value=8000000
RCC.APB2Freq_Value=8000000
board=custom

// file: Core/Src/main.c
/* USER CODE BEGIN Header */
/**
  ******************************************************************************
  * @file           : main.c
  * @brief          : Main program body
  ******************************************************************************
  * @attention
  *
  * Copyright (c) 2024 STMicroelectronics.
  * All rights reserved.
  *
  * This software is licensed under terms that can be found in the LICENSE file
  * in the root directory of this software component.
  * If no LICENSE file comes with this software, it is provided AS-IS.
  *
  ******************************************************************************
  */
/* USER CODE END Header */
#include "main.h"

/* USER CODE BEGIN Includes */
#include <stdio.h>
/* USER CODE END Includes */

/* USER CODE BEGIN PD */
#define GPIOB_BASE_ARR 0x40010C00
/* USER CODE END PD */

/* USER CODE BEGIN PM */
extern void initialise_monitor_handles(void);
/* USER CODE END PM */

/* USER CODE BEGIN PV */
//__attribute__((section(".ver"))) char version[4] = {1,2,3,4};
/* USER CODE END PV */

void SystemClock_Config(void);
static void MX_GPIO_Init(void);

/* USER CODE BEGIN 0 */
void leds_init()
{
	//set PB12 in output push-pull
	__HAL_RCC_GPIOB_CLK_ENABLE();
	uint32_t * GPIOB_CRH = (uint32_t *) (GPIOB_BASE_ARR + 0x04);
	*GPIOB_CRH |= (0b11 << 16);// set PB12 in OUTPUT mode speed 50MHz

	*GPIOB_CRH &= ~(0b11 << 18); //set PB12 output push-pull

	//set PC13 in output push-pull
	__HAL_RCC_GPIOC_CLK_ENABLE();

	GPIOC->CRH &= ~(0xF<<20);  // Clear Bits 23:22:21:20
	GPIOC->CRH |= (1<<20);  // PC13 Output mode 10 MHz, push pull
}

void led_control(char led_state)
{
	uint32_t * GPIOB_ODR = (uint32_t *) (GPIOB_BASE_ARR + 0x0C);
	if(led_state == 0)
	{
		*GPIOB_ODR |= (1<<12);
	}
	else
	{
		*GPIOB_ODR &= ~(1<<12);
	}
}

void led_toggle(){
	uint32_t * GPIOB_ODR = (uint32_t *) (GPIOB_BASE_ARR + 0x0C);

	if(((* GPIOB_ODR >> 12)&1)==0)
	{

		*GPIOB_ODR |= (1<<12);
	}
	else
	{
		*GPIOB_ODR &= ~(1<<12);
	}
}

char buff[100] = "Hello!";
/* USER CODE END 0 */

int main(void)
{
  /* USER CODE BEGIN 1 */
	initialise_monitor_handles();
  /* USER CODE END 1 */

  /* MCU Configuration--------------------------------------------------------*/

  /* Reset of all peripherals, Initializes the Flash interface and the Systick. */
  HAL_Init();

  /* Configure the system clock */
  SystemClock_Config();

  /* Initialize all configured peripherals */
  MX_GPIO_Init();
  /* USER CODE BEGIN 2 */
  leds_init();
  printf("Hello, World!\n");

  /* USER CODE END 2 */

  /* Infinite loop */
  while (1)
  {

    /* USER CODE BEGIN 3 */
	  printf("Enter string:\n");
	  fgets(buff, sizeof(buff), stdin);
	  printf(buff);
	  printf("\n");
	  led_toggle();
	  HAL_Delay(100);
//	GPIOC->BSRR |= (1<<13);  // Set the pin PC13
//	HAL_Delay(100);
//	GPIOC->BSRR |= (1<<29);  // RESET the pin PC13
//	HAL_Delay(100);
  }
  /* USER CODE END 3 */
}

void SystemClock_Config(void)
{
  RCC_OscInitTypeDef RCC_OscInitStruct = {0};
  RCC_ClkInitTypeDef RCC_ClkInitStruct = {0};

  /** Initializes the RCC Oscillators according to the specified parameters
  * in the RCC_OscInitTypeDef structure.
  */
  RCC_OscInitStruct.OscillatorType = RCC_OSCILLATORTYPE_HSI;
  RCC_OscInitStruct.HSIState = RCC_HSI_ON;
  RCC_OscInitStruct.HSICalibrationValue = RCC_HSICALIBRATION_DEFAULT;
  RCC_OscInitStruct.PLL.PLLState = RCC_PLL_NONE;
  if (HAL_RCC_OscConfig(&RCC_OscInitStruct) != HAL_OK)
  {
    Error_Handler();
  }

  /** Initializes the CPU, AHB and APB buses clocks
  */
  RCC_ClkInitStruct.ClockType = RCC_CLOCKTYPE_HCLK|RCC_CLOCKTYPE_SYSCLK
                              |RCC_CLOCKTYPE_PCLK1|RCC_CLOCKTYPE_PCLK2;
  RCC_ClkInitStruct.SYSCLKSource = RCC_SYSCLKSOURCE_HSI;
  RCC_ClkInitStruct.AHBCLKDivider = RCC_SYSCLK_DIV1;
  RCC_ClkInitStruct.APB1CLKDivider = RCC_HCLK_DIV1;
  RCC_ClkInitStruct.APB2CLKDivider = RCC_HCLK_DIV1;

  if (HAL_RCC_ClockConfig(&RCC_ClkInitStruct, FLASH_LATENCY_0) != HAL_OK)
  {
    Error_Handler();
  }
}

static void MX_GPIO_Init(void)
{

  /* GPIO Ports Clock Enable */
  __HAL_RCC_GPIOA_CLK_ENABLE();

}

void Error_Handler(void)
{
  __disable_irq();
  while (1)
  {
  }
}
